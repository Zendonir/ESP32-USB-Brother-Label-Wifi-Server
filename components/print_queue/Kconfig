## components/print_queue/Kconfig
```kconfig
menu "Print queue"

    config PRINT_QUEUE_MAX_JOB_BYTES
        int "Maximum size of one print job (bytes)"
        range 65536 8388608
        default 4194304
        help
            Jobs are spooled completely (in PSRAM) before they are sent to
            the printer, so an interrupted transfer never reaches it.

    config PRINT_QUEUE_MEMORY_BUDGET
        int "Memory for all spooled jobs incl. kept failed jobs (bytes)"
        range 65536 8388608
        default 6291456

    config PRINT_QUEUE_WAIT_PRINTER_S
        int "How long a job waits for the printer (not connected / error) before it fails (s)"
        range 10 86400
        default 600

endmenu
```

## components/raw_tcp_server/Kconfig
```kconfig
menu "RAW print server (port 9100)"

    config RAW_TCP_PORT
        int "TCP port"
        range 1 65535
        default 9100

    config RAW_TCP_IDLE_TIMEOUT_S
        int "Abort a job if no data arrives for (s)"
        range 5 600
        default 30

endmenu
```

## components/usb_printer/Kconfig
```kconfig
menu "USB printer transport"

    config USB_PRINTER_DUMP_ON_CONNECT
        bool "Print the full USB descriptor report on the console when a device is attached"
        default y

    config USB_PRINTER_ALLOW_VENDOR_INTERFACE
        bool "Also claim a vendor-specific (class 0xFF) interface with bulk OUT"
        default n
        help
            By default only a standard USB Printer Class interface (0x07/0x01) is
            claimed for print data. Enable this only after the diagnostic report
            of the real device has shown that print data must go to a
            vendor-specific interface.

    config USB_PRINTER_BULK_CHUNK_SIZE
        int "Bulk OUT transfer chunk size (bytes)"
        range 512 65536
        default 16384
        help
            Size of the DMA buffer used for one bulk OUT transfer. Larger print
            jobs are sent in several chunks of this size.

endmenu
```

## components/web_interface/Kconfig
```kconfig
menu "Diagnostic web interface"

    config DIAG_ENABLE_RAW_SEND
        bool "Compile in POST /api/diag/raw (forward request body unchanged to the printer)"
        default y
        help
            Development aid for phase 3: lets you send a print file that was
            produced by the ORIGINAL Brother driver ("print to file") to the
            printer. It is available after boot (like a network printer it
            accepts print data from the local network); 'raw_send off' on the
            serial console disables it until restart.

    config WEB_OTA_ENABLE
        bool "Firmware update over the web interface (POST /api/system/ota)"
        default y
        help
            Upload of brother_printserver.bin from the web interface. Accepted
            only from the home network, never over the open setup access point.
            The image is verified before it is activated; a firmware that does
            not start is rolled back by the bootloader.

endmenu
```

## components/wifi_manager/Kconfig
```kconfig
menu "Wi-Fi manager"

    config WIFI_MGR_AP_SSID_PREFIX
        string "Setup access point SSID prefix"
        default "Brother-PrintServer-Setup"
        help
            The last two bytes of the MAC address are appended, e.g.
            Brother-PrintServer-Setup-A1B2.

    config WIFI_MGR_FALLBACK_AP_DELAY_S
        int "Start setup AP if station is not connected after (seconds)"
        range 30 3600
        default 120

endmenu
```

## main/Kconfig.projbuild
```kconfig
menu "Brother print server"

    config APP_DEFAULT_HOSTNAME
        string "Default hostname (mDNS: <hostname>.local)"
        default "brother-td2020"

    config APP_RESET_BUTTON_GPIO
        int "GPIO of the button: short press = restart, held 10 s = Wi-Fi reset (-1 = off)"
        range -1 48
        default 0
        help
            GPIO0 is the BOOT button on ESP32-S3-DevKitC-1 compatible boards.
            Short press (released within 2 s): restart. Held for 10 s: erase
            the Wi-Fi credentials and restart into the open setup access point.
            Holding it during power-up enters the ROM download mode instead.

    config APP_EXT_BUTTON_GPIO
        int "GPIO of an external button (front panel) with the same function (-1 = off)"
        range -1 48
        default 4
        help
            Wire a push button between this GPIO and GND (internal pull-up, no
            resistor needed). It works exactly like the BOOT button: short press =
            restart, held 10 s = Wi-Fi reset. GPIO4 is free on ESP32-S3-DevKitC-1
            boards and no strapping pin. Avoid 0, 3, 45, 46 (strapping), 19/20
            (USB), 26-37 (flash/PSRAM), 43/44 (console) and 48 (RGB LED).

    config APP_USB_DEBUG_LOG
        bool "Log every USB attach/enumeration step (ESP-IDF tags HUB and ENUM at debug level)"
        default y
        help
            ESP-IDF reports a detected connection only at debug level. With
            this option the diagnostic firmware shows "Root port reset",
            enumeration stages and their results on the console. Only USB
            events produce output, so it is not noisy.

    config APP_LOG_BUFFER_SIZE
        int "Size of the in-RAM log buffer shown in the web interface (bytes)"
        range 4096 262144
        default 32768

endmenu
```
